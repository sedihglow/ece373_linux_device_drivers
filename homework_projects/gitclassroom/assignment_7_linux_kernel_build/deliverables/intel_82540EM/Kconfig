## homework_projects/gitclassroom/assignment_7_linux_kernel_build/deliverables/intel_82540EM/Kconfig
```kconfig
config I82540EM 
	tristate "Blink timer for intel 82540EM"
	depends on PCI
	help
	  This driver will blink LED0 on a timer once the dev file is open. Upon
	  close the timer is stopped.
```
